## conf/distro/pigeon-distro.conf
```bitbake
DISTRO = "pigeon-distro"
DISTRO_NAME = "pigeonOS"
DISTRO_VERSION = "1.0"

PACKAGE_CLASSES = "package_deb"

DEFAULT_TIMEZONE = "Europe/Warsaw"

DISTRO_FEATURES:remove = " \
	x11 \
	wayland \
	pulseaudio \
	directfb \
	bluetooth \
	irda \
	nfs \
	alsa \
	pulseaudio \
	"

DISTRO_FEATURES:append = " pam systemd"

# Define Init System
INIT_MANAGER = "systemd"

VIRTUAL-RUNTIME_dev-manager = "udev"
VIRTUAL-RUNTIME_init_manager = "systemd"
VIRTUAL-RUNTIME_initscripts = "systemd-compat-units"

VOLATILE_LOG_DIR = "no"
```

## conf/layer.conf
```bitbake
# We have a conf and classes directory, add to BBPATH
BBPATH .= ":${LAYERDIR}"

# We have recipes-* directories, add to BBFILES
BBFILES += "${LAYERDIR}/recipes-*/*/*.bb \
            ${LAYERDIR}/recipes-*/*/*.bbappend"

PIGEON_LAYER_PATH := "${LAYERDIR}"

BBFILE_COLLECTIONS += "pigeon"
BBFILE_PATTERN_pigeon = "^${LAYERDIR}/"
BBFILE_PRIORITY_pigeon = "12"

LAYERDEPENDS_pigeon = "core"
LAYERSERIES_COMPAT_pigeon = "scarthgap"
```

## wic/pigeon-mmc.wks
```
# The mmc storage layout:
# --------------------------
# | boot | rootfs |  data  |
# --------------------------

bootloader --ptable gpt

part /boot --source bootimg-partition --ondisk mmcblk0 --fstype=vfat --label boot --active --align 4096 --size 20
part / --source rootfs --ondisk mmcblk0 --fstype=ext4 --label root --align 4096
part /data --fixed-size 16M --ondisk mmcblk0 --fstype=ext4 --label data --align 4096 --fsoptions "defaults,x-systemd.growfs" --no-fstab-update
```
